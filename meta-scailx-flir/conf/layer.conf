## meta-scailx-flir/conf/layer.conf
```bitbake
# We have a conf and classes directory, add to BBPATH
BBPATH .= ":${LAYERDIR}"

# We have a packages directory, add to BBFILES
BBFILES += "${LAYERDIR}/recipes-*/*/*.bb \
            ${LAYERDIR}/recipes-*/*/*.bbappend"

BBFILE_COLLECTIONS += "flir-layer"
BBFILE_PATTERN_flir-layer := "^${LAYERDIR}/"
# give it a priority higher than scailx layer
BBFILE_PRIORITY_flir-layer = "14"

LAYERDEPENDS_flir-layer = "videology-bsp videology-distro"
LAYERSERIES_COMPAT_flir-layer = "scarthgap"

CORE_IMAGE_EXTRA_INSTALL:append = " flir-devicetrees-vvcam flir-devicetrees-vvcam kernel-module-flir kernel-module-flir-boson-vvcam python3-flir-boson-sdk flir-vvcam-driver "
```
